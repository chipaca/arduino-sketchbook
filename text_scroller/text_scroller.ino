// message scroller for arduino 8x8 matrix led thingie

#define MSG_LEN 100
// add two chars at the end of your message
char message[MSG_LEN+3] = "...";

// from X11 misc 5x8 pcf file. via:
// pcf2bdf /usr/share/fonts/X11/misc/5x8.pcf.gz | perl -00 -wne \\
// 'if (/^STARTCHAR (\w+).*BITMAP.(.*)ENDCHAR/ms) {$n=$1; $b=$2;
//  print("  {", join(", ", map("0x$_", $b =~ /(\w+)/g)), "}, // $n\n")}'
byte ascii[][8] = {
    {0x00, 0x00, 0x00, 0x00, 0x00, 0x00, 0x00, 0x00}, // space
    {0x00, 0x20, 0x20, 0x20, 0x20, 0x00, 0x20, 0x00}, // exclam
    {0x00, 0x50, 0x50, 0x50, 0x00, 0x00, 0x00, 0x00}, // quotedbl
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    {0x00, 0x50, 0xA0, 0x00, 0x00, 0x00, 0x00, 0x00}, // asciitilde
};

// FIXME: the 5x8ness of the font permeates the logic below.

byte msg[8] =  {0, 0, 0, 0, 0, 0, 0, 0};
int pos = 0; // char position in message
int message_len = 3;
byte off = 0; // column offset in char
byte tick = 0;

void setup() {
    int i;
    for (i=2; i<10; i++) {
        pinMode(i, OUTPUT);
        digitalWrite(i, LOW);
    }
    for (i=10; i<18; i++) {
        pinMode(i, OUTPUT);
        digitalWrite(i, HIGH);
    }
    Serial.begin(9600);
}

void loop() {
    if (Serial.available()) {
        // readBytesUntil takes an int to specify how much to read,
        //     and returns a byte of how much it read.
        // >head asplode<
        int n = Serial.readBytesUntil('\n', message, MSG_LEN);
        // n *should* be >0 here. Doesn't hurt to make sure.
        if (n) {
            message[n] = message[0];
            message[n+1] = message[1];
            message[n+2] = 0;
            // and reset the scroller:
            tick = 0;
            pos = 0;
            off = 0;
            message_len = strlen(message);
        }
    }
    int i, j;
    if (!tick) {
        for (i=0; i<8; i++) {
            msg[7-i] = ((ascii[message[pos  ]-' '][i] << off) & 255)
                + (ascii[message[pos+1]-' '][i] >> (5-off))
                + (ascii[message[pos+2]-' '][i] >> (10-off));
        }
        off++;
        if (off > 4) {
            pos++;
            off=0;
            if (pos >= message_len - 2) {
                pos = 0;
            }
        }
    }
    for (i=2; i<10; i++) {
        for (j=10; j<18; j++) {
            if ((msg[i-2] & (1<<(j-10))) != 0) {
                digitalWrite(j, LOW);
            } else {
                digitalWrite(j, HIGH);
            }
        }
        digitalWrite(i, HIGH);
        delay(1);
        digitalWrite(i, LOW);
    }
    tick = (tick+1) % 10;
}

// Local Variables:
// mode: c
// c-file-style: "cc-mode"
// End:
